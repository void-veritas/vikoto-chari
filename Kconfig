## Kconfig
```kconfig
# Workaround: maxtouch-zephyr-module's peacock_vik_module shield defines
# these symbols without types, causing Kconfig warnings that are fatal in
# Zephyr 4.1+ (KCONFIG_WARNINGS_AS_ERRORS). Provide type definitions here.
# Values below are for the Procyon trackpad sensor.

config ZMK_TRACKPAD_LOGICAL_X
	int "Trackpad logical X resolution"
	default 3685

config ZMK_TRACKPAD_LOGICAL_Y
	int "Trackpad logical Y resolution"
	default 2150

config ZMK_TRACKPAD_PHYSICAL_X
	int "Trackpad physical X dimension (hundredths of mm)"
	default 1560

config ZMK_TRACKPAD_PHYSICAL_Y
	int "Trackpad physical Y dimension (hundredths of mm)"
	default 910
```

## boards/sadekbaroudi/vikoto/Kconfig.vikoto
```kconfig
# Copyright (c) 2022 Sadek Baroudi
# SPDX-License-Identifier: MIT

config BOARD_VIKOTO
    select SOC_NRF52840_QIAA
```

## boards/shields/chari/Kconfig.defconfig
```kconfig
if SHIELD_CHARI_RIGHT

config ZMK_KEYBOARD_NAME
	default "Chari"

config ZMK_SPLIT_ROLE_CENTRAL
	default y

endif

if SHIELD_CHARI_DONGLE

config ZMK_KEYBOARD_NAME
	default "Chari"

config ZMK_SPLIT_ROLE_CENTRAL
	default y

endif

if SHIELD_CHARI_LEFT || SHIELD_CHARI_RIGHT || SHIELD_CHARI_DONGLE || SHIELD_CHARI_DONGLE_LEFT || SHIELD_CHARI_DONGLE_RIGHT

config ZMK_SPLIT
	default y

endif
```

## boards/shields/chari/Kconfig.shield
```kconfig
config SHIELD_CHARI_LEFT
	def_bool $(shields_list_contains,chari_left)

config SHIELD_CHARI_RIGHT
	def_bool $(shields_list_contains,chari_right)

config SHIELD_CHARI_DONGLE
	def_bool $(shields_list_contains,chari_dongle)

config SHIELD_CHARI_DONGLE_LEFT
	def_bool $(shields_list_contains,chari_dongle_left)

config SHIELD_CHARI_DONGLE_RIGHT
	def_bool $(shields_list_contains,chari_dongle_right)
```

## config/west.yml
```yaml
manifest:
  remotes:
    - name: zmkfirmware
      url-base: https://github.com/zmkfirmware
    - name: george-norton
      url-base: https://github.com/george-norton
    - name: void-veritas
      url-base: https://github.com/void-veritas
    - name: carrefinho
      url-base: https://github.com/carrefinho

  projects:
    - name: zmk
      remote: zmkfirmware
      revision: main
      import: app/west.yml

    - name: maxtouch-zephyr-module
      remote: void-veritas  # DEBUG: forked from george-norton with diagnostic logging
      revision: main

    - name: prospector-zmk-module
      remote: carrefinho
      revision: core/zephyr-4-1

  self:
    path: config
```
